## main/Kconfig.projbuild
```kconfig
menu "Main Configuration"

    orsource "$IDF_PATH/examples/common_components/env_caps/$IDF_TARGET/Kconfig.env_caps"

    config DHT_GPIO
        int "DHT GPIO number"
        range ENV_GPIO_RANGE_MIN ENV_GPIO_OUT_RANGE_MAX
        default 4
        help
            GPIO number (IOxx) to DHT.

    config BLINK_GPIO
        int "Blink GPIO number"
        range ENV_GPIO_RANGE_MIN ENV_GPIO_OUT_RANGE_MAX
        default 8
        help
            GPIO number (IOxx) to blink on and off the LED.
            Some GPIOs are used for other purposes (flash connections, etc.) and cannot be used to blink.

    config SNTP_TIME_SERVER
        string "SNTP server name"
        default "pool.ntp.org"
        help
            Hostname of the main SNTP server.

    config TIMEZONE
        string "Timezone"
        default "KST-9"
        help
            Timezone string, see <https://sourceware.org/glibc/manual/latest/html_node/Proleptic-TZ.html>.

    config BROKER_URL
        string "Broker URL"
        default "mqtt://mqtt.localdomain"
        help
            URL of the broker to connect to

    config MQTT_TOPIC
        string "MQTT Topic"
        default "/weather/data"
        help
            MQTT topic to publish the data to

endmenu
```
